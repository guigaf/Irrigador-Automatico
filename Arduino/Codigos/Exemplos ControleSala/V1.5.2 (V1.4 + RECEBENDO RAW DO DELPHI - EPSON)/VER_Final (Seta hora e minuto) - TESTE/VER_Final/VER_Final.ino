#include <SoftwareSerial.h>
#include <IRremote.h>
#include <virtuabotixRTC.h>

virtuabotixRTC myRTC(6, 7, 8);
SoftwareSerial serial1(10, 11); // RX, TX

IRsend irsend;

int w=0;
int indice1=-1;
int indice3=-1;
int horadesliga=22;
int mindesliga=00;
int auxtimeoff1[2];
int auxtimeoff11=-1;
int auxtimeoff2;
int auxtimeoff22=0;
int auxtimeoff3[2];
int auxtimeoff33=0;

unsigned int r=0;
unsigned int f=0;
unsigned int valor1[4];
unsigned int valor2;
unsigned int valor3[197];

boolean DSLIG=false;
boolean ACLIG=false;

boolean AC=false,DS=false;;
boolean HORA=false;

char dado;

int timer=0;

void setup() 
{

  //myRTC.setDS1302Time(00, 27, 14, 4, 6, 9, 2017); //segundo, minuto, hora, dia da semana, dia, mes, ano
  //delay(100);
  serial1.begin(38400);
  Serial.begin(38400);
  valor1[0]=0;
  valor1[1]=0;
  valor1[2]=0;
  valor1[3]=10;
  valor2=0;

}
void loop() 
{
  int khz = 38;
  myRTC.updateTime();
//-------------------------------------------------------------------------------------------
timer++;
if (timer>=1000)
{
  Serial.print("Hora : ");
  if (myRTC.hours < 10)
    {
      Serial.print("0");
    }
  Serial.print(myRTC.hours);
  Serial.print(":");
  if (myRTC.minutes < 10)
    {
      Serial.print("0");
    }
  Serial.print(myRTC.minutes);
  Serial.print(":");
  if (myRTC.seconds < 10)
    {
      Serial.print("0");
    }
  Serial.println(myRTC.seconds);
  Serial.println(DSLIG);
  timer=0;
}
//-------------------------------------------------------------------------------------------
  /*if ((DSLIG==true) && (myRTC.hours>=horadesliga) && (myRTC.minutes>=mindesliga))
    {
      delay(120000);
      Serial.println("DESLIGAR DS");
      irsend.sendNEC(0xC40BF, 32);//manda o sinal IR-DESLIGA
      delay(1000);
      irsend.sendNEC(0xC40BF, 32);
      DSLIG=false;
    }*/
//------------------------------------------------------------------------------------------- 
 /* if ((ACLIG==true) && (myRTC.hours>=horadesliga) && (myRTC.minutes>=mindesliga))
    {
      delay(5000);
      unsigned int irSignal[] = {6280, 7580, 560, 580, 600, 520, 580, 560, 580, 520, 620, 520, 560, 560, 600, 520, 600, 540, 580, 580, 580, 540, 560, 560, 600, 540, 580, 540, 600, 520, 600, 540, 560, 560, 600, 560, 520, 600, 600, 520, 600, 540, 580, 540, 600, 540, 540, 580, 580, 540, 580, 580, 580, 540, 600, 540, 540, 560, 620, 540, 560, 540, 560, 560, 600, 540, 520, 640, 580, 560, 560, 540, 600, 520, 600, 540, 560, 560, 600, 540, 580, 540, 560, 600, 580, 540, 560, 560, 600, 540, 520, 600, 600, 520, 600, 540, 540, 580, 600, 560, 500, 620, 600, 520, 600, 540, 560, 560, 600, 540, 500, 600, 600, 520, 620, 560, 580, 540, 600, 540, 500, 1720, 580, 1640, 580, 1640, 600, 1640, 540, 560, 600, 580, 560, 560, 600, 540, 580, 520, 600, 520, 600, 540, 540, 580, 600, 520, 600, 1660, 600, 540, 500, 620, 600, 1620, 580, 540, 600, 540, 520, 600, 600, 1640, 540, 1720, 500, 600, 600, 1640, 580, 540, 600, 540, 500, 1720, 580, 540, 560, 1660, 520, 640, 600, 1620, 600, 1640, 500, 620, 580, 560, 560, 1640, 600, 540, 500, 1720, 580, 7580, 580};
      Serial.println("DESLIGAR AC");
      irsend.sendRaw(irSignal, sizeof(irSignal) / sizeof(irSignal[0]), khz);
      ACLIG=false;
    }*/
//-------------------------------------------------------------------------------------------              
  while (serial1.available()>0)  //se byte pronto para leitura
  {
    if ((!AC) && (!DS) && (!HORA))
    {
      dado=serial1.read();
    }
//-------------------------------------------------------------------------------------------
    if (HORA==true)
    {
      char m = serial1.read();
      unsigned int hora(m);
      f=hora-48;
      //Serial.println(f);
      Serial.println(f);
//-------------------------------------------------------------------------------------------
      if (m!=':')
      {
        auxtimeoff11++;
        auxtimeoff1[auxtimeoff11]=f;
        f=0;
      }
//-------------------------------------------------------------------------------------------
      if (m==':')
      {
        //Serial.println(auxtimeoff33);
        auxtimeoff22++;
          auxtimeoff1[0]=auxtimeoff1[0]*10;
          auxtimeoff1[1]=auxtimeoff1[1]*1;
          auxtimeoff2=auxtimeoff1[0]+auxtimeoff1[1];
        if (auxtimeoff33==1)
        {
          auxtimeoff33++;  
          mindesliga=auxtimeoff2;        
          //Serial.println(mindesliga);
          //Serial.println("entrou em minutos");
        }
        if (auxtimeoff33==0)
        {
          auxtimeoff33++;
          horadesliga=auxtimeoff2;
          //Serial.println(horadesliga);
          //Serial.println("entrou em horas");
        }
        auxtimeoff11=-1;
        f=0;
        //Serial.println(auxtimeoff33);
      }
//-------------------------------------------------------------------------------------------
        if (auxtimeoff22>=2)
        {
          //Serial.print(horadesliga);
          //Serial.print(':');
          //Serial.print(mindesliga);    
          //Serial.println(' ');
          HORA=false;
          hora=' ';
          auxtimeoff1[0]=0;
          auxtimeoff1[1]=0;
          auxtimeoff1[2]=0;                    
          auxtimeoff11=-1;
          auxtimeoff2=0;
          auxtimeoff22=0;
          auxtimeoff3[0]=0;
          auxtimeoff3[1]=0;
          auxtimeoff3[2]=0;                   
          auxtimeoff33=0;
        }

    }
//-------------------------------------------------------------------------------------------
    if (AC==true)
    {
      w++;
      char c = serial1.read();
      unsigned int sig(c);
      r=sig-48;
//-------------------------------------------------------------------------------------------
      if (c!=',')
      {
        indice1++;
        valor1[indice1]=r;
        r=0;
      }
//-------------------------------------------------------------------------------------------
      if (c==',')
      {
        if (valor1[3]!=10)
        {
          valor1[0]=valor1[0]*1000;
          valor1[1]=valor1[1]*100;
          valor1[2]=valor1[2]*10;
          valor2=valor1[0]+valor1[1]+valor1[2]+valor1[3];    
        }
        if (valor1[3]==10)
        {
          valor1[0]=valor1[0]*100;
          valor1[1]=valor1[1]*10;
          valor1[2]=valor1[2]*1;
          valor2=valor1[0]+valor1[1]+valor1[2];
        }
        if (indice3<197)
        {
          indice3++;
          valor3[indice3]=valor2;
          //Serial.println(indice3);
        }
        valor1[3]=10;
        indice1=-1;
        r=0;
      }
//-------------------------------------------------------------------------------------------      
        if (indice3>=196)
        {
          AC=false;
        }
    }
//-------------------------------------------------------------------------------------------      
    if (DS==true)
    {
      switch(serial1.read())  //verifica qual caracter recebido
        {
//--------------------------------------------------------------------------------------------------------------------------------------------------------------------------------
          case 'A':       //caso 'A' = 65
            {
              irsend.sendNEC(0xC1AA09F6, 32);    //manda o sinal IR-LIGA/DESLIGA
              delay(1000);
              irsend.sendNEC(0xC1AA09F6, 32);
              DSLIG=!DSLIG;
              break;
            }
//--------------------------------------------------------------------------------------------------------------------------------------------------------------------------------
          case 'B':     //caso 'B' = 66
            {
              irsend.sendNEC(0xC1AA31CE, 32);    //manda o sinal IR-SORCE SEARCH
              break;
            }
//--------------------------------------------------------------------------------------------------------------------------------------------------------------------------------     
          case 'C':       //caso 'C' = 67
            {
              irsend.sendNEC(0xC1AA29D6, 32);    //manda o sinal IR-COMPUTER
              break;
            }
//--------------------------------------------------------------------------------------------------------------------------------------------------------------------------------               
          case 'D':       //caso 'D' = 68
            {
              irsend.sendNEC(0xC1AA0EF1, 32);    //manda o sinal IR-VIDEO
              break;
            }
//--------------------------------------------------------------------------------------------------------------------------------------------------------------------------------
                                
          case 'E':       //caso 'E' = 69
            {
              irsend.sendNEC(0xC1AA6E91, 32);    //manda o sinal IR-USB
              break;
            }
//--------------------------------------------------------------------------------------------------------------------------------------------------------------------------------
          case 'F':       //caso 'F' = 70
            {
              irsend.sendNEC(0xC1AA2ED1, 32);    //manda o sinal IR-LAN
              break;
            }
//-------------------------------------------------------------------------------------------------------------------------------------------------------------------------------- 
          case 'G':       //caso 'G' = 71
            {
              irsend.sendNEC(0xC1AA7986, 32);    //manda o sinal IR-7/AUTO
              break;
            }
//-------------------------------------------------------------------------------------------------------------------------------------------------------------------------------- 
          case 'H':       //caso 'H' = 72
            {
              irsend.sendNEC(0xC1AA51AE, 32);    //manda o sinal IR-8/ASPECT
              break;
            }
//-------------------------------------------------------------------------------------------------------------------------------------------------------------------------------- 
          case 'I':       //caso 'I' = 73
            {
              irsend.sendNEC(0xC1AAF10E, 32);    //manda o sinal IR-COLOR MODE
              break;
            }
//-------------------------------------------------------------------------------------------------------------------------------------------------------------------------------- 
          case 'J':       //caso 'J' = 74
            {
              irsend.sendNEC(0xC1AA59A6, 32);    //manda o sinal IR-MENU
              break;
            }
//-------------------------------------------------------------------------------------------------------------------------------------------------------------------------------- 
          case 'K':       //caso 'K' = 75
            {
              irsend.sendNEC(0xC1AA21DE, 32);    //manda o sinal IR-ESC
              break;
            }
//-------------------------------------------------------------------------------------------------------------------------------------------------------------------------------- 
          case 'L':       //caso 'L' = 76
            {
              irsend.sendNEC(0xC1AAF906, 32);    //manda o sinal IR-USER
              break;
            }
//-------------------------------------------------------------------------------------------------------------------------------------------------------------------------------- 
          case 'M':       //caso 'M' = 77
            {
              irsend.sendNEC(0xC1AAD926, 32);    //manda o sinal IR-POINTER
              break;
            }
//-------------------------------------------------------------------------------------------------------------------------------------------------------------------------------- 
          case 'N':       //caso 'N' = 78
            {
              irsend.sendNEC(0xC1AA0DF2, 32);    //manda o sinal IR-UP
              break;
            }
//-------------------------------------------------------------------------------------------------------------------------------------------------------------------------------- 
          case 'O':       //caso 'O' = 79
            {
              irsend.sendNEC(0xC1AA4DB2, 32);    //manda o sinal IR-DOWN
              break;
            }
//-------------------------------------------------------------------------------------------------------------------------------------------------------------------------------- 
          case 'P':       //caso 'P' = 80
            {
              irsend.sendNEC(0xC1AA8D72, 32);    //manda o sinal IR-RIGHT
              break;
            }
//-------------------------------------------------------------------------------------------------------------------------------------------------------------------------------- 
          case 'Q':       //caso 'Q' = 81
            {
              irsend.sendNEC(0xC1AACD32, 32);    //manda o sinal IR-LEFT
              break;
            }
//-------------------------------------------------------------------------------------------------------------------------------------------------------------------------------- 
          case 'R':       //caso 'R' = 82
            {
              irsend.sendNEC(0xC1AAA15E, 32);    //manda o sinal IR-CENTER
              break;
            }
//-------------------------------------------------------------------------------------------------------------------------------------------------------------------------------- 
          case 'S':       //caso 'S' = 83
            {
              irsend.sendNEC(0xC1AA619E, 32);    //manda o sinal IR-PAGE_UP
              break;
            }
//-------------------------------------------------------------------------------------------------------------------------------------------------------------------------------- 
          case 'T':       //caso 'T' = 84
            {
              irsend.sendNEC(0xC1AAE11E, 32);    //manda o sinal IR-PAGE_DOWN
              break;
            }
//--------------------------------------------------------------------------------------------------------------------------------------------------------------------------------
          case 'U':       //caso 'U' = 85
            {
              irsend.sendNEC(0xC1AA11EE, 32);    //manda o sinal IR-ZOOM_UP
              break;
            }
//--------------------------------------------------------------------------------------------------------------------------------------------------------------------------------
          case 'V':       //caso 'V' = 86
            {
              irsend.sendNEC(0xC1AA916E, 32);    //manda o sinal IR-ZOOM_DOWN
              break;
            }
//--------------------------------------------------------------------------------------------------------------------------------------------------------------------------------
          case 'W':       //caso 'W' = 87
            {
              irsend.sendNEC(0xC1AA19E6, 32);    //manda o sinal IR-VOL_UP
              break;
            }
//--------------------------------------------------------------------------------------------------------------------------------------------------------------------------------
          case 'X':       //caso 'X' = 88
            {
              irsend.sendNEC(0xC1AA9966, 32);    //manda o sinal IR-VOL_DOWN
              break;
            }
//--------------------------------------------------------------------------------------------------------------------------------------------------------------------------------
          case 'Y':       //caso 'Y' = 89
            {
              irsend.sendNEC(0xC1AAC936, 32);    //manda o sinal IR-A/V MUTE
              break;
            }
//--------------------------------------------------------------------------------------------------------------------------------------------------------------------------------
          case 'a':       //caso 'a' = 97
            {
              irsend.sendNEC(0xC1AA49B6, 32);    //manda o sinal IR-FREEZE
              break;
            }
//--------------------------------------------------------------------------------------------------------------------------------------------------------------------------------
          case 'b':       //caso 'b' = 98
            {
              irsend.sendNEC(0xC1AAA956, 32);    //manda o sinal IR-HELP
              break;
            }                                    
//--------------------------------------------------------------------------------------------------------------------------------------------------------------------------------
        }
      DS=false;
    }
//-------------------------------------------------------------------------------------------  
     if (dado=='Z')
    {
       AC=true;
       DS=false;
       HORA=false;
       Serial.println("AC");
       dado=' ';
    }
    if (dado=='z')
    {
       AC=false;
       DS=true;
       HORA=false;
       Serial.println("DS");
       dado=' ';
    }
    if (dado=='[')
    {
       AC=false;
       DS=false;
       HORA=true;
       Serial.println("HORA Confirmada");
       dado=' ';  
    }
  }
//--------------------------------------------------------------------------------------------------------------------------------------------------------------------------------
  if (valor3[196]!=0)
  {
    for(int i = 0; i < 196; i++)
    {
      Serial.print(valor3[i]);
      Serial.print(",");
    }
    for(int o = 196; o < 197; o++)
    {
      Serial.println(valor3[o]);
    }
    Serial.println("ENVIADO");
    irsend.sendRaw(valor3, sizeof(valor3) / sizeof(valor3[0]), khz);
    ACLIG=true;
    w=0;
    indice1=-1;
    indice3=-1;
    r=0;
    valor1[0]=0;
    valor1[1]=0;
    valor1[2]=0;
    valor1[3]=10;
    valor2=0;
    valor3[196]=0;
  }
//--------------------------------------------------------------------------------------------------------------------------------------------------------------------------------
}

