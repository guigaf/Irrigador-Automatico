#include <SoftwareSerial.h>
#include <IRremote.h>
#include <virtuabotixRTC.h>           

virtuabotixRTC myRTC(6, 7, 8);
SoftwareSerial serial1(10, 11); // RX, TX

IRsend irsend;
boolean aux1=0;

char e=0;

int q=0;
int w=0;
int indice1=-1;
int indice3=-1;

unsigned int r=0;
unsigned int valor1[4];
unsigned int valor2;
unsigned int valor3[197];

boolean escreve=true;

void setup() 
{
  serial1.begin(9600);
  Serial.begin(9600);
  valor1[0]=0;
  valor1[1]=0;
  valor1[2]=0;
  valor1[3]=10;
  valor2=0;
  //myRTC.setDS1302Time(15, 33, 17, 4, 28, 06, 2017);
}

void loop() 
{
  myRTC.updateTime();
  int khz = 38; // 38kHz carrier frequency for the NEC protocol
//-------------------------------------------------------------------------------------------
  /*Serial.print("Hora : ");
  if (myRTC.hours < 10)
    {
      Serial.print("0");
    }
  Serial.print(myRTC.hours);
  Serial.print(":");
  if (myRTC.minutes < 10)
    {
      Serial.print("0");
    }
  Serial.print(myRTC.minutes);
  Serial.print(":");
  if (myRTC.seconds < 10)
    {
      Serial.print("0");
    }
  Serial.println(myRTC.seconds);*/
//-------------------------------------------------------------------------------------------
  /*if ((aux1==1) && (myRTC.hours>=22))
    {
      Serial.println("DESLIGAR");
      irsend.sendNEC(0xC40BF, 32);//manda o sinal IR-DESLIGA
      delay(1000);
      irsend.sendNEC(0xC40BF, 32); 
      aux1=0;   
    }*/
//-------------------------------------------------------------------------------------------              
  if (serial1.available()>0)  //se byte pronto para leitura
  { 
//-------------------------------------------------------------------------------------------              
    if ((serial1.available()>0) && (serial1.available()<20))  //se byte pronto para leitura
    {
    w++;
    q=0;
    char c = serial1.read();
    unsigned int sig(c);
    r=sig-48;
//-------------------------------------------------------------------------------------------
    if (c!=',')
    {
      indice1++;
      valor1[indice1]=r;
      r=0;
      q=0;
    }
//-------------------------------------------------------------------------------------------
    if (c==',')
    {
      if (valor1[3]!=10)
      {
        valor1[0]=valor1[0]*1000;
        valor1[1]=valor1[1]*100;
        valor1[2]=valor1[2]*10;
        valor2=valor1[0]+valor1[1]+valor1[2]+valor1[3];    
      }
      if (valor1[3]==10)
      {
        valor1[0]=valor1[0]*100;
        valor1[1]=valor1[1]*10;
        valor1[2]=valor1[2]*1;
        valor2=valor1[0]+valor1[1]+valor1[2];
      }
      if (indice3<197)
      {
        indice3++;
        valor3[indice3]=valor2;
      }
      valor1[3]=10;
      indice1=-1;
      r=0;
      q=0;
    }
//-------------------------------------------------------------------------------------------
  escreve=true;    
    }
//-------------------------------------------------------------------------------------------
    if (serial1.available()>20)  //se byte pronto para leitura
    {
      switch(serial1.read())  //verifica qual caracter recebido
        {
//--------------------------------------------------------------------------------------------------------------------------------------------------------------------------------
          case 'A':       //caso 'A' = 65
            {
              irsend.sendNEC(0xC40BF, 32);    //manda o sinal IR-LIGA 
              break;
            }
//--------------------------------------------------------------------------------------------------------------------------------------------------------------------------------
          case 'B':     //caso 'B' = 66
            {
              irsend.sendNEC(0xC40BF, 32);//manda o sinal IR-DESLIGA
              delay(1000);
              irsend.sendNEC(0xC40BF, 32); 
              aux1=!aux1;
              break;
            }
//--------------------------------------------------------------------------------------------------------------------------------------------------------------------------------     
          case 'C':       //caso 'C' = 67
            {
              irsend.sendNEC(0xCC03F, 32);    //manda o sinal IR-PAUSE/PLAY  
              break;
            }
//--------------------------------------------------------------------------------------------------------------------------------------------------------------------------------               
          case 'D':       //caso 'D' = 68
            {
              irsend.sendNEC(0xCF00F, 32);    //manda o sinal IR-MENU
              break;
            }
//--------------------------------------------------------------------------------------------------------------------------------------------------------------------------------
                                
          case 'E':       //caso 'E' = 69
            {
              irsend.sendNEC(0xC10EF, 32);    //manda o sinal IR-AUTO
              break;
            }
//--------------------------------------------------------------------------------------------------------------------------------------------------------------------------------
          case 'F':       //caso 'F' = 70
            {
              irsend.sendNEC(0xC20DF, 32);    //manda o sinal IR-SOURCE
              break;
            }
//-------------------------------------------------------------------------------------------------------------------------------------------------------------------------------- 
          case 'G':       //caso 'G' = 71
            {
              irsend.sendNEC(0xC08F7, 32);    //manda o sinal IR-MODE
              break;
            }
//-------------------------------------------------------------------------------------------------------------------------------------------------------------------------------- 
          case 'H':       //caso 'H' = 72
            {
              irsend.sendNEC(0xC0CF3, 32);    //manda o sinal IR-SMART ECO
              break;
            }
//-------------------------------------------------------------------------------------------------------------------------------------------------------------------------------- 
          case 'I':       //caso 'I' = 73
            {
              irsend.sendNEC(0xCE01F, 32);    //manda o sinal IR-ECO BLANK
              break;
            }
//-------------------------------------------------------------------------------------------------------------------------------------------------------------------------------- 
          case 'J':       //caso 'J' = 74
            {
              irsend.sendNEC(0xCD02F, 32);    //manda o sinal IR-UP
              break;
            }
//-------------------------------------------------------------------------------------------------------------------------------------------------------------------------------- 
          case 'K':       //caso 'K' = 75
            {
              irsend.sendNEC(0xC30CF, 32);    //manda o sinal IR-DOWN
              break;
            }
//-------------------------------------------------------------------------------------------------------------------------------------------------------------------------------- 
          case 'L':       //caso 'L' = 76
            {
              irsend.sendNEC(0xC708F, 32);    //manda o sinal IR-RIGHT
              break;
            }
//-------------------------------------------------------------------------------------------------------------------------------------------------------------------------------- 
          case 'M':       //caso 'M' = 77
            {
              irsend.sendNEC(0xCB04F, 32);    //manda o sinal IR-LEFT
              break;
            }
//-------------------------------------------------------------------------------------------------------------------------------------------------------------------------------- 
          case 'N':       //caso 'N' = 78
            {
              irsend.sendNEC(0xC41BE, 32);    //manda o sinal IR-VOL_UP
              break;
            }
//-------------------------------------------------------------------------------------------------------------------------------------------------------------------------------- 
          case 'O':       //caso 'O' = 79
            {
              irsend.sendNEC(0xCC13E, 32);    //manda o sinal IR-VOL_DOWN
              break;
            }
//-------------------------------------------------------------------------------------------------------------------------------------------------------------------------------- 
          case 'P':       //caso 'P' = 80
            {
              irsend.sendNEC(0xC18E7, 32);    //manda o sinal IR-ZOOM_UP
              break;
            }
//-------------------------------------------------------------------------------------------------------------------------------------------------------------------------------- 
          case 'Q':       //caso 'Q' = 81
            {
              irsend.sendNEC(0xC9867, 32);    //manda o sinal IR-ZOOM_DOWN
              break;
            }
//-------------------------------------------------------------------------------------------------------------------------------------------------------------------------------- 
          case 'R':       //caso 'R' = 82
            {
              irsend.sendNEC(0xCA05F, 32);    //manda o sinal IR-PAGE_UP
              break;
            }
//-------------------------------------------------------------------------------------------------------------------------------------------------------------------------------- 
          case 'S':       //caso 'S' = 83
            {
              irsend.sendNEC(0xC609F, 32);    //manda o sinal IR-PAGE_DOWN
              break;
            }
//-------------------------------------------------------------------------------------------------------------------------------------------------------------------------------- 
          case 'T':       //caso 'T' = 84
            {
              irsend.sendNEC(0xCA45B, 32);    //manda o sinal IR-ON
              break;
            }
//--------------------------------------------------------------------------------------------------------------------------------------------------------------------------------
          case 'U':       //caso 'U' = 85
            {
              irsend.sendNEC(0xC649B, 32);    //manda o sinal IR-SET_UP
              break;
            }
        }                    
      } 
q=0;       
  }
//--------------------------------------------------------------------------------------------------------------------------------------------------------------------------------
if ((serial1.available()==0) && (q<=2000))
  {
    q++;
    delay(1);
  }
//--------------------------------------------------------------------------------------------------------------------------------------------------------------------------------
if ((q>=1000) && (escreve==true))
  {
    for(int i = 0; i < 196; i++)
    {
      Serial.print(valor3[i]);
      Serial.print(",");
    }
    for(int o = 196; o < 197; o++)
    {
      Serial.println(valor3[o]);
    }
    irsend.sendRaw(valor3, sizeof(valor3) / sizeof(valor3[0]), khz); 
    q=0;
    w=0;
    indice1=-1;
    indice3=-1;
    r=0;
    valor1[0]=0;
    valor1[1]=0;
    valor1[2]=0;
    valor1[3]=10;
    valor2=0;
    valor3[0]=0;
    escreve=false;
//--------------------------------------------------------------------------------------------------------------------------------------------------------------------------------
}
}

