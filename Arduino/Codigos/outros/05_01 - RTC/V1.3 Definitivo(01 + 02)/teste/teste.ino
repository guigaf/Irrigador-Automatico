#include <SoftwareSerial.h>
#include <IRremote.h>
#include <virtuabotixRTC.h>           

SoftwareSerial serial1(10, 11); // RX, TX
virtuabotixRTC myRTC(6, 7, 8);// myRTC(clock, data, rst)

int lig = 0;

IRsend irsend;

void setup() 
{
  Serial.begin(9600);
  serial1.begin(9600);
  // Apos setar as informacoes, comente a linha abaixo
  // (segundos, minutos, hora, dia da semana, dia do mes, mes, ano)
  myRTC.setDS1302Time(50, 59, 21, 5, 22, 06, 2017);

}

void loop()  
{
  // Le as informacoes do CI
  myRTC.updateTime(); 

  if (serial1.available()<=0)  //se byte pronto para leitura
  {
      Serial.print("Hora : ");
      // Adiciona um 0 caso o valor da hora seja <10
        if (myRTC.hours < 10)
          {
            Serial.print("0");
          }
       Serial.print(myRTC.hours);
       Serial.print(":");
            // Adiciona um 0 caso o valor dos minutos seja <10
        if (myRTC.minutes < 10)
            {
              Serial.print("0");
            }
        Serial.print(myRTC.minutes);
        Serial.print(":");
        // Adiciona um 0 caso o valor dos segundos seja <10
        if (myRTC.seconds < 10)
          {
            Serial.print("0");
          }
        Serial.println(myRTC.seconds);
        delay(1000);

        if ((myRTC.hours>=22) && (myRTC.minutes>=00) && (myRTC.seconds>=00))
          {
            irsend.sendNEC(0xC40BF, 32);//manda o sinal IR-DESLIGA
            delay(1000);
            irsend.sendNEC(0xC40BF, 32);
            lig=!lig;
          }
  }





  
  if (serial1.available()>0)  //se byte pronto para leitura
    { 
      switch(serial1.read())  //verifica qual caracter recebido
        {
//--------------------------------------------------------------------------------------------------------------------------------------------------------------------------------               

//--------------------------------------------------------------------------------------------------------------------------------------------------------------------------------               
          case 'B':     //caso 'B' = 66
            {
              irsend.sendNEC(0xC40BF, 32);//manda o sinal IR-DESLIGA
              delay(1000);
              irsend.sendNEC(0xC40BF, 32);
              lig=!lig;
              break;
            }
//--------------------------------------------------------------------------------------------------------------------------------------------------------------------------------     
          case 'C':       //caso 'C' = 67
            {
              irsend.sendNEC(0xCC03F, 32);    //manda o sinal IR-PAUSE/PLAY  
              break;
            }
//--------------------------------------------------------------------------------------------------------------------------------------------------------------------------------               
          case 'D':       //caso 'D' = 68
            {
              irsend.sendNEC(0xCF00F, 32);    //manda o sinal IR-MENU
              break;
            }
//--------------------------------------------------------------------------------------------------------------------------------------------------------------------------------
                                
          case 'E':       //caso 'E' = 69
            {
              irsend.sendNEC(0xC10EF, 32);    //manda o sinal IR-AUTO
              break;
            }
//--------------------------------------------------------------------------------------------------------------------------------------------------------------------------------
          case 'F':       //caso 'F' = 70
            {
              irsend.sendNEC(0xC20DF, 32);    //manda o sinal IR-SOURCE
              break;
            }
//-------------------------------------------------------------------------------------------------------------------------------------------------------------------------------- 
          case 'G':       //caso 'G' = 71
            {
              irsend.sendNEC(0xC08F7, 32);    //manda o sinal IR-MODE
              break;
            }
//-------------------------------------------------------------------------------------------------------------------------------------------------------------------------------- 
          case 'H':       //caso 'H' = 72
            {
              irsend.sendNEC(0xC0CF3, 32);    //manda o sinal IR-SMART ECO
              break;
            }
//-------------------------------------------------------------------------------------------------------------------------------------------------------------------------------- 
          case 'I':       //caso 'I' = 73
            {
              irsend.sendNEC(0xCE01F, 32);    //manda o sinal IR-ECO BLANK
              break;
            }
//-------------------------------------------------------------------------------------------------------------------------------------------------------------------------------- 
          case 'J':       //caso 'J' = 74
            {
              irsend.sendNEC(0xCD02F, 32);    //manda o sinal IR-UP
              break;
            }
//-------------------------------------------------------------------------------------------------------------------------------------------------------------------------------- 
          case 'K':       //caso 'K' = 75
            {
              irsend.sendNEC(0xC30CF, 32);    //manda o sinal IR-DOWN
              break;
            }
//-------------------------------------------------------------------------------------------------------------------------------------------------------------------------------- 
          case 'L':       //caso 'L' = 76
            {
              irsend.sendNEC(0xC708F, 32);    //manda o sinal IR-RIGHT
              break;
            }
//-------------------------------------------------------------------------------------------------------------------------------------------------------------------------------- 
          case 'M':       //caso 'M' = 77
            {
              irsend.sendNEC(0xCB04F, 32);    //manda o sinal IR-LEFT
              break;
            }
//-------------------------------------------------------------------------------------------------------------------------------------------------------------------------------- 
          case 'N':       //caso 'N' = 78
            {
              irsend.sendNEC(0xC41BE, 32);    //manda o sinal IR-VOL_UP
              break;
            }
//-------------------------------------------------------------------------------------------------------------------------------------------------------------------------------- 
          case 'O':       //caso 'O' = 79
            {
              irsend.sendNEC(0xCC13E, 32);    //manda o sinal IR-VOL_DOWN
              break;
            }
//-------------------------------------------------------------------------------------------------------------------------------------------------------------------------------- 
          case 'P':       //caso 'P' = 80
            {
              irsend.sendNEC(0xC18E7, 32);    //manda o sinal IR-ZOOM_UP
              break;
            }
//-------------------------------------------------------------------------------------------------------------------------------------------------------------------------------- 
          case 'Q':       //caso 'Q' = 81
            {
              irsend.sendNEC(0xC9867, 32);    //manda o sinal IR-ZOOM_DOWN
              break;
            }
//-------------------------------------------------------------------------------------------------------------------------------------------------------------------------------- 
          case 'R':       //caso 'R' = 82
            {
              irsend.sendNEC(0xCA05F, 32);    //manda o sinal IR-PAGE_UP
              break;
            }
//-------------------------------------------------------------------------------------------------------------------------------------------------------------------------------- 
          case 'S':       //caso 'S' = 83
            {
              irsend.sendNEC(0xC609F, 32);    //manda o sinal IR-PAGE_DOWN
              break;
            }
//-------------------------------------------------------------------------------------------------------------------------------------------------------------------------------- 
          case 'T':       //caso 'T' = 84
            {
              irsend.sendNEC(0xCA45B, 32);    //manda o sinal IR-ON
              break;
            }
//-------------------------------------------------------------------------------------------------------------------------------------------------------------------------------- 
          case 'U':       //caso 'U' = 85
            {
              irsend.sendNEC(0xC649B, 32);    //manda o sinal IR-SET_UP
              break;
            }                                                                        
//--------------------------------------------------------------------------------------------------------------------------------------------------------------------------------                                                                                    
//--------------------------------------------------------------------------------------------------------------------------------------------------------------------------------  

          
        }
    }
}

